#define CONFIG_WIRELESS
#define ZMK_BASE_LAYER(name, LT, RT, LM, RM, LB, RB, LH, RH)                   \
    ZMK_LAYER(                                                                 \
        name,                                                                  \
           &none LT RT &none                                                   \
           &none LM RM &none                                                   \
           &none LB RB &none                                                   \
           &none LH RH &none                                                   \
    )

#include "zmk-helpers/key-labels/42.h"
//#include "zmk-helpers/key-labels/36.h"
#include "base.keymap"

/{ chosen { zmk,physical-layout = &foostan_corne_6col_layout; }; };
///{ chosen { zmk,physical-layout = &foostan_corne_5col_layout; }; };
